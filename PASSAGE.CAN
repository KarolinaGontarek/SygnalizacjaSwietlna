/*@!Encoding:1250*/
on message lol
{
  write("hehehehe");
}