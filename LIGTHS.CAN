/*@!Encoding:1250*/
variables
{
  message hard_bit hardbit;
  message start star;
  message m1_1 m11;
  message m1_2 m12;
  message m2_1 m21;
  message m2_2 m22;
  message m3_2 m32;
  message m3_1 m31;
  message m4_1 m41;
  message m4_2 m42;
  message breakdown bd;
  
  timer t11;
  timer t12;
  timer t13;
  timer t21;
  timer t22;
  timer t23;
  timer t31;
  timer t32;
  timer t33;
  timer t41;
  timer t42;
  timer t43;
  timer bd1;
  timer bd2;
  
  int numOfCars1;
  int numOfCars2;
  int numOfCars3;
  int numOfCars4;
}



on message hard_bit
{
  
  putValue(hard_light,1);
}

on message m1_1
{
  if(check_bits())
    setTimer(t11,1);
  else 
   output(bd);
  
  putValue(hard_pass,0);
  putValue(hard_light,0);
}

on timer t11
{
  clear();
  putValue(yellow_1,1);
  //czas trwania światła zielonego zależy od timex
  settimer(t12,1);
}

on timer t12
{
  clear();
  write("time1: %d", getValue(time1));
  putValue(red_1,0);
  putValue(green_1,1);
  setTimer(t13,getValue(time1));
  output(m12);
}

on timer t13
{
  clear();
  putValue(red_1,0);
  putValue(yellow_1,1);
  
  //ile aut przejechało
  numOfCars1 = getValue(cars_1) - getValue(time1)*2;
  if( numOfCars1 < 0)
    numOfCars1 = 0;
  putValue(cars_1,numOfCars1);
  
  output(m21); 
}

on message m2_1
{
  if(check_bits())
    setTimer(t21,1);
  else 
   output(bd);
    
  putValue(hard_pass,0);
  putValue(hard_light,0);
}



on timer t21
{
  clear();
  putValue(yellow_2,1);
  //czas trwania światła zielonego zależy od timex
  setTimer(t22,1);
}

on timer t22
{
  clear();
  write("time2: %d", getValue(time2));
  putValue(red_2,0);
  putValue(green_2,1);
  setTimer(t23,getValue(time2));
}

on timer t23
{
  clear();
  putValue(red_2,0);
  putValue(yellow_2,1);
  
  //ile aut przejechało
  numOfCars2 = getValue(cars_2) - getValue(time2)*2;
  if( numOfCars2 < 0)
    numOfCars2 = 0;
  putValue(cars_2,numOfCars2);
  
  output(m31);
}

on message m3_1
{
  if(check_bits())
    setTimer(t31,1);
  else 
   output(bd);
    
  putValue(hard_pass,0);
  putValue(hard_light,0);
}

on timer t31
{
  clear();
  putValue(yellow_3,1);
  //czas trwania światła zielonego zależy od timex
  setTimer(t32,1);
}

on timer t32
{
  clear();
  write("time3: %d", getValue(time3));
  putValue(red_3,0);
  putValue(green_3,1);
  output(m32);
  setTimer(t33, getValue(time3));
}

on timer t33
{
  clear();
  putValue(red_3,0);
  putValue(yellow_3,1);
  
  //ile aut przejechało
  numOfCars3 = getValue(cars_3) - getValue(time3)*2;
  if( numOfCars3 < 0)
    numOfCars3 = 0;
  putValue(cars_3,numOfCars3);
  
  output(m41);
}

on message m4_1
{
  if(check_bits())
    setTimer(t41,1);
  else 
   output(bd);
    
  putValue(hard_pass,0);
  putValue(hard_light,0);
}

on timer t41
{
  clear();
  putValue(yellow_4,1);
  //czas trwania światła zielonego zależy od timex
  setTimer(t42,1);
}

on timer t42
{
  clear();
  write("time4: %d", getValue(time4));
  putValue(red_4,0);
  putValue(green_4,1);
  setTimer(t43, getValue(time4));
}

on timer t43
{
  clear();
  putValue(red_4,0);
  putValue(yellow_4,1);
  
  //ile aut przejechało
  numOfCars4 = getValue(cars_4) - getValue(time4)*2;
  if( numOfCars4 < 0)
    numOfCars4 = 0;
  putValue(cars_4,numOfCars4);
  
  output(star);
}

void clear()
{
  putValue(green_1,0);
  putValue(green_2,0);
  putValue(green_3,0);
  putValue(green_4,0);
  putValue(yellow_1,0);
  putValue(yellow_2,0);
  putValue(yellow_3,0);
  putValue(yellow_4,0);
  putValue(red_1,1);
  putValue(red_2,1);
  putValue(red_3,1);
  putValue(red_4,1);
  putValue(P1,0);
  putValue(P2,0);
  putValue(P3,0);
  putValue(P4,0);
}


int check_bits()
{
  if(getValue(hard_light) == 0 || getValue(hard_pass) == 0 ){
    return 0;
  }
  else
    output(hardbit);
  if(getValue(hard_light) == 0 || getValue(hard_pass) == 0 )
  {
    return 0;
  }
  else
    return 1;
}


