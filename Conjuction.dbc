VERSION ""

NS_ :

BS_:

BU_:

BO_ 3221225472 VECTOR__INDEPENDENT_SIG_MSG: 0 Vector__XXX
 SG_ Ligth2 : 0|1@1+ (1,0) [0|1] "" Vector__XXX
 SG_ Ligth1 : 0|1@1+ (1,0) [0|1] "" Vector__XXX
 SG_ Pass : 0|1@1+ (1,0) [0|1] "" Vector__XXX

BO_ 339 lol: 8 Vector__XXX

BO_ 337 Temporary: 8 Vector__XXX

BO_ 336 changeSwitch: 1 Vector__XXX

EV_ pedestrian_1: 0 [0|1] "" 0 1 DUMMY_NODE_VECTOR0 Vector__XXX;

EV_ yellow_1: 0 [0|1] "" 0 2 DUMMY_NODE_VECTOR0 Vector__XXX;

EV_ green_1: 0 [0|1] "" 1 3 DUMMY_NODE_VECTOR0 Vector__XXX;

EV_ red_1: 0 [0|1] "" 0 4 DUMMY_NODE_VECTOR0 Vector__XXX;

CM_ BO_ 3221225472 "This is a message for not used signals, created by Vector CANdb++ DBC OLE DB Provider.";
BA_DEF_  "BusType" STRING ;
BA_DEF_DEF_  "BusType" "CAN";
