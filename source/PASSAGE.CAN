/*@!Encoding:1250*/

//zmienia zmienną PassSwitch na to co dostanie w Passage (sygnał Pass)
on message Passage{
  sysSetVariableInt(sysvar::Passage::PassSwitch, this.Pass);
}
