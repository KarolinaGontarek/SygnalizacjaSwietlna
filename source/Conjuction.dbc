VERSION ""

NS_ :

BS_:

BU_:

BO_ 336 changeSwitch: 1 Vector__XXX

BO_ 1024 Lights: 1 Vector__XXX
 SG_ Ligth2 : 1|1@1+ (1,0) [0|1] "" Vector__XXX
 SG_ Ligth1 : 0|1@1+ (1,0) [0|1] "" Vector__XXX

BO_ 512 Passage: 1 Vector__XXX
 SG_ Pass : 0|1@1+ (1,0) [0|1] "" Vector__XXX

BA_DEF_  "BusType" STRING ;
BA_DEF_DEF_  "BusType" "CAN";
