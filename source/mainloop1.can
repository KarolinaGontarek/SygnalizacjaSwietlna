/*@!Encoding:1250*/


//deklaruję zmienne używane przez program
variables
{
  int amount_of_cars1=0;//ilosć aut przy jednym sygnalizatorze, początkowo 0
  int amount_of_cars2=0;//ilosć aut przy drugim sygnalizatorze, początkowo 0
  message Passage passage;//wiadomość wysyłana do LIGHT (czy włączyć czy wyłączyć światła)
  message Lights ligths;//wiadomość wysyłana do PASSAGE (czy włączyć czy wyłączyć światła na przejściu)
}


//reaguje na wiadomość changeSwitch generowaną co 1 sekundę (będzie jeszcze do zmiany)
on message changeSwitch{
  
  //początkowo samochody mogą jeździć
  ligths.Ligth1  = 1;
  ligths.Ligth2  = 1;
  passage.Pass = 0;//a piesi nie przechodzą
  output(ligths);//wysyłam tę wiadomość na magistralę 
  output(passage);//wysyłam tę wiadomość na magistralę
  
  amount_of_cars1 -=5;//zmniejszam ilość aut o 5 
  amount_of_cars2 -= 5;
  if(amount_of_cars1<0)//jeśli jest mniej niż 0 to ustawiam na 0
     amount_of_cars1=0;
  if(amount_of_cars2<0)
     amount_of_cars2=0;
  
   write("aoc1= %d aoc2 = %d \n", amount_of_cars1,amount_of_cars2);//na konsoli wypisuję liczbę aut pod sygnalizatorami
  
  //nowe wiadomości, piesi przechodzą, auta stoją
  ligths.Ligth1  = 0;
  ligths.Ligth2  = 0;
  passage.Pass = 1;
  output(ligths);
  output(passage);
  
  amount_of_cars1 += random(10);//losuję ile przyjedzie aut do jednego i drugiego skrzyżowania z zakresu od 1 do 9 włącznie
  amount_of_cars2 += random(10); 
  
  //koniec iteracji, następna co sekundę
}

